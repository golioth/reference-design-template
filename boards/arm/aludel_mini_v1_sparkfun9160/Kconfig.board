## boards/arm/aludel_mini_v1_sparkfun9160/Kconfig.board
```kconfig
# Sparkfun nRF9160 Thing Plus configuration

# Copyright (c) 2018-2020 Nordic Semiconductor ASA
# Copyright (c) 2020 Circuit Dojo LLC
# SPDX-License-Identifier: Apache-2.0

if SOC_NRF9160_SICA

config BOARD_ALUDEL_MINI_V1_SPARKFUN9160
	bool "Golioth Aludel-Mini v1 using Sparkfun nRF9160"

config BOARD_ALUDEL_MINI_V1_SPARKFUN9160_NS
	bool "Golioth Aludel-Mini v1 using Sparkfun nRF9160 non-secure"

endif # SOC_NRF9160_SICA
```

## boards/golioth/aludel_elixir/Kconfig.aludel_elixir
```kconfig
# Copyright (c) 2024 Golioth, Inc.
# SPDX-License-Identifier: Apache-2.0

config BOARD_ALUDEL_ELIXIR
	select SOC_NRF9160_SICA
```

## boards/golioth/aludel_elixir/aludel_elixir_defconfig
```kconfig
# Copyright (c) 2023 Golioth, Inc.
# SPDX-License-Identifier: Apache-2.0

# Enable MPU
CONFIG_ARM_MPU=y

# Enable hardware stack protection
CONFIG_HW_STACK_PROTECTION=y

# Enable TrustZone-M
CONFIG_ARM_TRUSTZONE_M=y

# Enable GPIO
CONFIG_GPIO=y

# Enable UART console
CONFIG_SERIAL=y
CONFIG_CONSOLE=y
CONFIG_UART_CONSOLE=y

# Enable pin controller drivers
CONFIG_PINCTRL=y
```

## boards/golioth/aludel_elixir/aludel_elixir_ns_defconfig
```kconfig
# Copyright (c) 2023 Golioth, Inc.
# SPDX-License-Identifier: Apache-2.0

# Enable MPU
CONFIG_ARM_MPU=y

# Enable hardware stack protection
CONFIG_HW_STACK_PROTECTION=y

# Enable TrustZone-M
CONFIG_ARM_TRUSTZONE_M=y

# This Board implies building Non-Secure firmware
CONFIG_TRUSTED_EXECUTION_NONSECURE=y

# Enable GPIO
CONFIG_GPIO=y

# Enable UART console
CONFIG_SERIAL=y
CONFIG_CONSOLE=y
CONFIG_UART_CONSOLE=y

# Enable pin controller drivers
CONFIG_PINCTRL=y

# Enable power regulator control
#CONFIG_REGULATOR=y
```

## boards/golioth/aludel_elixir/board.yml
```yaml
board:
  name: aludel_elixir
  vendor: golioth
  revision:
    format: letter
    default: B
    exact: true
    revisions:
    - name: A
    - name: B
  socs:
    - name: nrf9160
      variants:
        - name: ns
```

## boards/golioth/aludel_mini/Kconfig
```kconfig
# Circuit Dojo nRF9160 Feather configuration

# Copyright (c) 2018-2020 Nordic Semiconductor ASA
# Copyright (c) 2020 Circuit Dojo LLC
# Copyright (c) 2024 Golioth Inc.
# SPDX-License-Identifier: Apache-2.0

config BOARD_ALUDEL_MINI
	# The GPIO driver is required by this board's initialization code
	# (board.c), so it is forced here to be enabled always, not only
	# enabled by default (in defconfig).
	select GPIO
```

## boards/golioth/aludel_mini/Kconfig.aludel_mini
```kconfig
# Copyright (c) 2020 Circuit Dojo LLC
# SPDX-License-Identifier: Apache-2.0

config BOARD_ALUDEL_MINI
	select SOC_NRF9160_SICA
```

## boards/golioth/aludel_mini/board.yml
```yaml
board:
  name: aludel_mini
  vendor: golioth
  socs:
    - name: nrf9160
      variants:
        - name: 'ns'
```

## src/battery_monitor/Kconfig
```kconfig
#
# Copyright (C) 2023 Golioth, Inc.
#
# SPDX-License-Identifier: Apache-2.0
#

config ALUDEL_BATTERY_MONITOR
	bool "Battery monitoring library for the Golioth RD Template"
	help
	  Build and link common code for the battery monitor.

if ALUDEL_BATTERY_MONITOR

config ALUDEL_BATTERY_MONITOR_VOLTAGE_DIVIDER
	bool
	depends on !DT_HAS_MAXIM_MAX17262_ENABLED
	default y
	select ADC
	select ADC_ASYNC
	select ADC_NRFX_SAADC
	help
	  Select symbols necessary for measuring battery voltage with a voltage divider.

config ALUDEL_BATTERY_MONITOR_MAX17262
	bool
	depends on DT_HAS_MAXIM_MAX17262_ENABLED
	default y
	select SENSOR
	help
	  Select symbols necessary for measuring battery voltage with the MAX17262 fuel gauge.

endif # ALUDEL_BATTERY_MONITOR
```
